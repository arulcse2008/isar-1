## meta-isar/conf/machine/qemui386.conf
```bitbake
# This software is a part of ISAR.
# Copyright (C) 2017 ilbers GmbH
DISTRO_ARCH ?= "i386"

KERNEL_NAME ?= "686-pae"

IMAGE_TYPE ?= "wic-img"
WKS_FILE ?= "directdisk-isar"
IMAGER_INSTALL += "${SYSLINUX_BOOTLOADER_INSTALL}"

QEMU_ARCH ?= "i386"
QEMU_MACHINE ?= "pc"
QEMU_CPU ?= ""
QEMU_DISK_ARGS ?= "-hda ##ROOTFS_IMAGE##"

MACHINE_SERIAL ?= "ttyS0"
BAUDRATE_TTY ?= "115200"

# when enabled, rebuilding the initramfs fails with out-of-space error
IMAGE_INSTALL_remove = "enable-fsck"
```
